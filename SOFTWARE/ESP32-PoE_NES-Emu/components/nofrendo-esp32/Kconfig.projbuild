## SOFTWARE/ESP32-PoE_NES-Emu/components/nofrendo-esp32/Kconfig.projbuild
```kconfig
menu "Nofrendo ESP32-specific configuration"

choice NOFRENDO_HARDWARE
	prompt "Hardware to run on"
	default ESP_WROVER_KIT_V2_ILI
	help
		This emulator can run on various types of hardware. Select what you have here.

config HW_WROVERKIT_V1
	bool "ESP_Wrover_Kit v1 (red PCB)"

config HW_WROVERKIT_V2
	bool "ESP_Wrover_Kit v2 (black PCB)"

config HW_CUSTOM
	bool "Custom hardware"

endchoice

choice HW_LCD_TYPE_SEL
	prompt "LCD type"
	depends on HW_CUSTOM || HW_WROVERKIT_V2

config HW_LCD_TYPE_ILI
	bool "ILI9341 LCD"

config HW_LCD_TYPE_ST
	bool "ST7789V LCD"

endchoice

config HW_WROVERKIT
	bool
	default n if HW_CUSTOM
	default y if HW_WROVERKIT_V1
	default y if HW_WROVERKIT_V2


config HW_LCD_TYPE
	int
	default 0 if HW_WROVERKIT_V1
	default 0 if HW_LCD_TYPE_ILI
	default 1 if HW_LCD_TYPE_ST

config HW_LCD_MISO_GPIO_CUST
	int "LCD MISO pin"
	depends on HW_CUSTOM
	range -1 35
	default 0

config HW_LCD_MOSI_GPIO_CUST
	int "LCD MOSI pin"
	depends on HW_CUSTOM
	range 1 35
	default 2

config HW_LCD_CLK_GPIO_CUST
	int "LCD CLK pin"
	depends on HW_CUSTOM
	range 1 35
	default 14

config HW_LCD_CS_GPIO_CUST
	int "LCD CS pin"
	depends on HW_CUSTOM
	range 1 35
	default 5

config HW_LCD_DC_GPIO_CUST
	int "LCD DC pin"
	depends on HW_CUSTOM
	range 1 35
	default 15

config HW_LCD_RESET_GPIO_CUST
	int "LCD RESET pin"
	depends on HW_CUSTOM
	range -1 35
	default 0

config HW_LCD_BL_GPIO_CUST
	int "LCD Backlight Enable pin"
	depends on HW_CUSTOM
	range 1 35
	default 4

config HW_INV_BL_CUST
	bool "Invert backlight output"
	default n
	depends on HW_CUSTOM


config HW_INV_BL
	bool
	default HW_INBV_BL_CUST if HW_CUSTOM
	default n if HW_WROVERKIT_V1
	default y if HW_WROVERKIT_V2

config HW_LCD_MISO_GPIO
	int
	default HW_LCD_MISO_GPIO_CUST if HW_CUSTOM
	default 25 if HW_WROVERKIT

config HW_LCD_MOSI_GPIO
	int
	default HW_LCD_MOSI_GPIO_CUST if HW_CUSTOM
	default 23 if HW_WROVERKIT

config HW_LCD_CLK_GPIO
	int
	default HW_LCD_CLK_GPIO_CUST if HW_CUSTOM
	default 19 if HW_WROVERKIT

config HW_LCD_CS_GPIO
	int
	default HW_LCD_CS_GPIO_CUST if HW_CUSTOM
	default 22 if HW_WROVERKIT

config HW_LCD_DC_GPIO
	int
	default HW_LCD_DC_GPIO_CUST if HW_CUSTOM
	default 21 if HW_WROVERKIT

config HW_LCD_RESET_GPIO
	int
	default HW_LCD_RESET_GPIO_CUST if HW_CUSTOM
	default 18 if HW_WROVERKIT

config HW_LCD_BL_GPIO
	int
	default HW_LCD_BL_GPIO_CUST if HW_CUSTOM
	default 5 if HW_WROVERKIT


config SOUND_ENA
	bool "Analog audio on GPIO26"
	default n
	help 
		ESP32 will output 0-3.3V analog audio signal on GPIO26.



config HW_TS_ENA
	bool "Enable I2C Touch Screen controller input"
	default y
	help
		If you connect a I2C of Touch Screen to following GPIOs, you can control the NES.


config TS_PLAYER
	int "Select which player Touch Screen controls (1 or 2)"
	depends on HW_TS_ENA
	range 1 2
	default 1

config HW_TS_I2C_NUM
	int "Touch Screen I2C Number"
	depends on HW_TS_ENA
	range 1 2
	default 1

config HW_TS_CLK
	int "Touch Screen I2C CLK GPIO pin"
	depends on HW_TS_ENA
	range 1 35
	default 16

config HW_TS_DAT
	int "Touch Screen I2C DATA GPIO pin"
	depends on HW_TS_ENA
	range 1 35
	default 13



config HW_NUNCHUCK_ENA
	bool "Enable I2C MOD-Wii-UEXT-Nunchuck controller input"
	default y
	help
		If you connect a I2C pins on UEXT of the NUNCHUCK to following GPIOs, you can control the NES.


config NUNCHUCK_PLAYER
	int "Select which player MOD-Wii-UEXT-Nunchuck controls (1 or 2)"
	depends on HW_NUNCHUCK_ENA
	range 1 2
	default 1

config HW_NUNCHUCK_I2C_NUM
	int "MOD-Wii-UEXT-Nunchuck I2C Number"
	depends on HW_NUNCHUCK_ENA
	range 1 2
	default 1

config HW_NUNCHUCK_CLK
	int "MOD-Wii-UEXT-Nunchuck I2C CLK GPIO pin"
	depends on HW_NUNCHUCK_ENA
	range 1 35
	default 16

config HW_NUNCHUCK_DAT
	int "MOD-Wii-UEXT-Nunchuck I2C DATA GPIO pin"
	depends on HW_NUNCHUCK_ENA
	range 1 35
	default 13

endmenu
```
